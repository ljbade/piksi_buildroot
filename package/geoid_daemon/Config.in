## package/geoid_daemon/Config.in
```kconfig
config BR2_PACKAGE_GEOID_DAEMON
  bool "geoid_daemon"
  select BR2_PACKAGE_CZMQ
  select BR2_PACKAGE_LIBSBP
  select BR2_PACKAGE_LIBPIKSI
  select BR2_PACKAGE_LIBCURL
  select BR2_PACKAGE_LIBNETWORK
```
